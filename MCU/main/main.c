/*
 * MIT License
 *
 * Copyright (c) 2025 huxiangjs
 *
 * Permission is hereby granted, free of charge, to any person obtaining a copy
 * of this software and associated documentation files (the "Software"), to deal
 * in the Software without restriction, including without limitation the rights
 * to use, copy, modify, merge, publish, distribute, sublicense, and/or sell
 * copies of the Software, and to permit persons to whom the Software is
 * furnished to do so, subject to the following conditions:
 *
 * The above copyright notice and this permission notice shall be included in all
 * copies or substantial portions of the Software.
 *
 * THE SOFTWARE IS PROVIDED "AS IS", WITHOUT WARRANTY OF ANY KIND, EXPRESS OR
 * IMPLIED, INCLUDING BUT NOT LIMITED TO THE WARRANTIES OF MERCHANTABILITY,
 * FITNESS FOR A PARTICULAR PURPOSE AND NONINFRINGEMENT. IN NO EVENT SHALL THE
 * AUTHORS OR COPYRIGHT HOLDERS BE LIABLE FOR ANY CLAIM, DAMAGES OR OTHER
 * LIABILITY, WHETHER IN AN ACTION OF CONTRACT, TORT OR OTHERWISE, ARISING FROM,
 * OUT OF OR IN CONNECTION WITH THE SOFTWARE OR THE USE OR OTHER DEALINGS IN THE
 * SOFTWARE.
 */

#include <stdio.h>
#include <stdlib.h>
#include <string.h>
#include <sys/types.h>
#include <sys/stat.h>
#include <fcntl.h>
#include <dirent.h>
#include <unistd.h>
#include <errno.h>
#include <freertos/FreeRTOS.h>
#include <freertos/task.h>
#include <freertos/queue.h>
#include <freertos/semphr.h>
#include <esp_system.h>
#include <esp_spi_flash.h>
#include <esp_log.h>
#include <nvs_flash.h>

#include "event_bus.h"
#include "keyboard.h"
#include "store.h"
#include "simple_ctrl.h"
#include "wifi.h"
#include "ir_ctrl.h"
#include "gpio_led.h"
#include "tcp_crypto.h"
#include "ota.h"
#include "ota_flash.h"
#include "os.h"
#include <git_version.h>

static const char *TAG = "APP-MAIN";

#define KEYBOARD_GPIO_PIN		GPIO_NUM_0
#define IR_RX_GPIO_PIN			GPIO_NUM_12
#define IR_TX_GPIO_PIN			GPIO_NUM_14
#define LED_GREEN_GPIO_PIN		GPIO_NUM_4
#define LED_RED_GPIO_PIN		GPIO_NUM_5

#define LED_GREEN_BRIGHTNESS_MAX	32
#define LED_RED_BRIGHTNESS_MAX		255

#define SPIFFS_ROOT_PATH		"/spiffs"
#define SPIFFS_ROOT_PATH_LEN		(sizeof(SPIFFS_ROOT_PATH) - 1)
#define IR_DATA_PREFIX			"IRDATA-"
#define IR_DATA_PREFIX_LEN		(sizeof(IR_DATA_PREFIX) - 1)

#define IR_CMD_GET_COUNT		0x00
#define IR_CMD_GET_ITEM			0x01
#define IR_CMD_TX_TEST			0x02
#define IR_CMD_SAVE			0x03
#define IR_CMD_REMOVE			0x04
#define IR_CMD_TX_SEND			0x05
#define IR_CMD_OPEN_TUNNEL		0x06
#define IR_CMD_CLOSE_TUNNEL		0x07
#define IR_CMD_DOWNLOAD_KEY		0x08
#define IR_CMD_UPLOAD_KEY		0x09

#define IR_NOTIFY_TYPE_RX		0x00
#define IR_NOTIFY_TYPE_KEY		0x01
#define IR_NOTIFY_TYPE_TX		0x02

#define IR_RESULT_OK			0x00
#define IR_RESULT_FAIL			0x01
#define IR_RESULT_DONE			0x02

#define IR_KEY_NUM_MAX			100
#define IR_KEY_NAME_LEN_MAX		100

/*
 * Maximum length of a key file name ("IRDATA-" + name).
 *
 * The SPIFFS in this SDK rejects names longer than
 * CONFIG_SPIFFS_OBJ_NAME_LEN - 1, and the VFS passes the object
 * path with a leading '/', so a full-length name needs
 * 1 + IR_DATA_PREFIX_LEN + IR_KEY_NAME_LEN_MAX bytes; the SPIFFS
 * config in sdkconfig is set to fit that.
 */
#define IR_KEY_FILE_NAME_LEN_MAX	(IR_DATA_PREFIX_LEN + IR_KEY_NAME_LEN_MAX)

static bool config_mode;
static QueueHandle_t led_queue;
static SemaphoreHandle_t ir_mutex;
static uint16_t ir_rx_buff[RX_BUFF_SIZE_MAX];
static uint16_t ir_rx_len;
static uint32_t ir_rx_count;

struct key_info {
	bool vaild;
	char name[IR_KEY_NAME_LEN_MAX + 1];
};

static uint32_t ir_key_count;
static struct key_info ir_key_info[IR_KEY_NUM_MAX];

static void app_show_info(void)
{
	int size = esp_get_free_heap_size();

	ESP_LOGI(TAG, "Free heap size: %dbytes", size);
}

static void print_build_info(void)
{
	/*
	 * Version tracking: which commit the firmware was built from (git
	 * branch + short sha, with a "-dirty" marker for uncommitted changes),
	 * when it was built, and which SDK it was built with. The APP_GIT_*
	 * macros are defined in build/include/git_version.h, generated by the
	 * project Makefile from the git state at build time (empty strings
	 * when git is unavailable).
	 */
	ESP_LOGI(TAG, "Build: git %s/%s%s, built %s %s",
		 APP_GIT_BRANCH, APP_GIT_SHA, APP_GIT_DIRTY,
		 __DATE__, __TIME__);
	ESP_LOGI(TAG, "SDK: %d.%d.%d (%s)",
		 ESP_IDF_VERSION_MAJOR, ESP_IDF_VERSION_MINOR,
		 ESP_IDF_VERSION_PATCH, IDF_VER);
}

static void print_chip_info(void)
{
	/* Print chip information */
	esp_chip_info_t chip_info;

	esp_chip_info(&chip_info);
	ESP_LOGI(TAG, "This is ESP8266 chip with %d CPU cores, WiFi, silicon revision %d, %dMB %s flash",
		 chip_info.cores, chip_info.revision, spi_flash_get_chip_size() / (1024 * 1024),
		 (chip_info.features & CHIP_FEATURE_EMB_FLASH) ? "embedded" : "external");
}

/* Rebuild cache when key is added/removed */
static void app_ir_key_cache_build(void)
{
	DIR *dp;
	struct dirent *ep;
	uint32_t file_count = 0;

	dp = opendir(SPIFFS_ROOT_PATH);
	ESP_ERROR_CHECK(dp == NULL);
	// rewinddir(dp);

	ir_key_count = 0;
	memset(ir_key_info, 0, sizeof(ir_key_info));

	printf("File list:\n");
	while ((ep = readdir(dp))) {
		printf("    %s/%s\n", SPIFFS_ROOT_PATH, ep->d_name);
		if (!strncmp(ep->d_name, IR_DATA_PREFIX, IR_DATA_PREFIX_LEN)) {
			strncpy(ir_key_info[ir_key_count].name, ep->d_name + IR_DATA_PREFIX_LEN,
				sizeof(ir_key_info[ir_key_count].name));
			ir_key_info[ir_key_count].vaild = true;
			ir_key_count++;
		}
		file_count++;
	}
	printf("File count: %u, Key count: %u\n", file_count, ir_key_count);

	closedir(dp);
}

/* When a key is added/removed, notify all connected devices to update the list */
static void app_notify_key_changed(void)
{
	char buffer[5];

	buffer[0] = IR_NOTIFY_TYPE_KEY;
	buffer[1] = (char)((ir_key_count >> 0) & 0xff);
	buffer[2] = (char)((ir_key_count >> 8) & 0xff);
	buffer[3] = (char)((ir_key_count >> 16) & 0xff);
	buffer[4] = (char)((ir_key_count >> 24) & 0xff);
	simple_ctrl_notify(buffer, sizeof(buffer));
}

static void app_led_set_step(char step)
{
	xQueueSend(led_queue, (void *)&step, (TickType_t)0);
}

/* Key transfer via the encrypted tunnel */

#define TUNNEL_KEY_DATA_MAX		(RX_BUFF_SIZE_MAX * sizeof(uint16_t))
/* Key data is streamed to/from the file in tunnel messages of at most
 * this many bytes, so no full-size buffer is needed. 256 matches the
 * SPIFFS page size (one fwrite per page) and halves the frame count vs
 * 128, cutting per-message framing overhead */
#define TUNNEL_KEY_CHUNK		256
/* Whole-frame I/O buffer for the tunnel crypto layer, chosen here at
 * session start: a frame is 2 (length) + 16 (IV) + ciphertext, and the
 * buffer must fit the largest message (1024 bytes of headroom over the
 * 256-byte key chunk): 2 + 16 + 1024 = 1042, 16-aligned gives 1056.
 * Each connection holds two of these (one per direction) */
#define TUNNEL_IO_BUF_SIZE		(2 + 16 + 1024 + 15) & ~15

/*
 * Tunnel session policy (app level).
 *
 * The fixed port avoids the control (54542) and discovery (54543) ports.
 * The idle timeout guards against the app crashing and holding the
 * tunnel forever.
 */
#define TUNNEL_PORT			54550
#define TUNNEL_IO_TIMEOUT_MS		5000
#define TUNNEL_IDLE_TIMEOUT_MS		5000
#define TUNNEL_LOOP_TIMEOUT_MS		100

#define TUNNEL_SESSION_STACK		4096
#define TUNNEL_SESSION_MAX_OPS		2

enum tunnel_op {
	TUNNEL_OP_NONE,
	TUNNEL_OP_CLOSE,
	TUNNEL_OP_DOWNLOAD,
	TUNNEL_OP_UPLOAD,
};

/* An operation queued to the tunnel session task */
struct tunnel_op_msg {
	int op;
	char name[IR_KEY_NAME_LEN_MAX + 1];
	uint32_t size;
};

/*
 * One tunnel session: a single client on the encrypted transport,
 * driven by its own task. The session task is the only thread that
 * touches the transport, other threads only queue operations.
 */
struct tunnel_session {
	/* The listening socket and the current (authenticated) client,
	 * both owned by the session task */
	int listen_fd;
	struct tcp_crypto *client;
	uint8_t key[TCP_CRYPTO_KEY_LENGTH];
	QueueHandle_t op_queue;
	TaskHandle_t task;
	/* The task sets finished when it has closed the transport and
	 * cleaned up (no use-after-free) */
	volatile bool finished;
	uint32_t last_active_ms;
};

/* The current (or recently dead) tunnel session */
static struct tunnel_session *tunnel;

/* Get the size (bytes) of a stored key, <0 if it does not exist */
static int app_key_get_size(const char *name, uint32_t *size)
{
	char file_path[SPIFFS_ROOT_PATH_LEN + 1 + IR_DATA_PREFIX_LEN + IR_KEY_NAME_LEN_MAX + 1];
	struct stat st;

	/* stat() reads the size from the SPIFFS index, no data access */
	snprintf(file_path, sizeof(file_path), SPIFFS_ROOT_PATH "/" IR_DATA_PREFIX "%s", name);
	if (stat(file_path, &st) != 0)
		return -1;
	*size = (uint32_t)st.st_size;
	return 0;
}

/*
 * Send the key data of `op` to the tunnel client (download). The data
 * is streamed from the file in TUNNEL_KEY_CHUNK-byte tunnel messages,
 * so no full-size buffer is needed.
 */
static int app_tunnel_do_download(struct tcp_crypto *tc,
		const struct tunnel_op_msg *op)
{
	char file_path[SPIFFS_ROOT_PATH_LEN + 1 + IR_DATA_PREFIX_LEN + IR_KEY_NAME_LEN_MAX + 1];
	uint8_t chunk[TUNNEL_KEY_CHUNK];
	FILE *fp;
	uint32_t sent = 0;
	uint32_t want;
	size_t len;

	snprintf(file_path, sizeof(file_path), SPIFFS_ROOT_PATH "/" IR_DATA_PREFIX "%s", op->name);
	fp = fopen(file_path, "rb");
	if (!fp) {
		ESP_LOGE(TAG, "Download failed (Open)");
		return -1;
	}
	while (sent < op->size) {
		want = op->size - sent;
		if (want > TUNNEL_KEY_CHUNK)
			want = TUNNEL_KEY_CHUNK;
		len = fread(chunk, 1, want, fp);
		if (len == 0) {
			ESP_LOGE(TAG, "Download failed (Read, %u/%u)",
				 (unsigned int)sent, (unsigned int)op->size);
			fclose(fp);
			return -1;
		}
		if (tcp_crypto_send(tc, chunk, (int)len,
				TUNNEL_IO_TIMEOUT_MS) < 0) {
			ESP_LOGE(TAG, "Download failed (Send)");
			fclose(fp);
			return -1;
		}
		sent += (uint32_t)len;
	}
	fclose(fp);

	ESP_LOGI(TAG, "Key [%s] data sent (%ub)", op->name, (unsigned int)op->size);
	return 0;
}

/*
 * Save the key data received from the tunnel client (upload). The data
 * arrives as TUNNEL_KEY_CHUNK-byte tunnel messages and is written to the
 * file as it comes in, so no full-size buffer is needed.
 *
 * Returns 0 on success, -1 on failure (the file is removed then).
 */
static int app_tunnel_do_upload(struct tcp_crypto *tc,
		const struct tunnel_op_msg *op)
{
	char file_path[SPIFFS_ROOT_PATH_LEN + 1 + IR_DATA_PREFIX_LEN + IR_KEY_NAME_LEN_MAX + 1];
	uint8_t chunk[TUNNEL_KEY_CHUNK];
	FILE *fp;
	uint32_t received = 0;
	uint32_t want;
	size_t len;
	int size;

	snprintf(file_path, sizeof(file_path), SPIFFS_ROOT_PATH "/" IR_DATA_PREFIX "%s", op->name);
	fp = fopen(file_path, "wb");
	if (!fp) {
		ESP_LOGE(TAG, "Upload failed (Open)");
		return -1;
	}
	while (received < op->size) {
		want = op->size - received;
		if (want > TUNNEL_KEY_CHUNK)
			want = TUNNEL_KEY_CHUNK;

		size = tcp_crypto_recv(tc, chunk, (int)want,
				TUNNEL_IO_TIMEOUT_MS);
		if (size <= 0) {
			ESP_LOGE(TAG, "Upload failed (Recv, %u/%u)",
				 (unsigned int)received, (unsigned int)op->size);
			break;
		}
		len = fwrite(chunk, 1, (size_t)size, fp);
		if (len != (size_t)size) {
			ESP_LOGE(TAG, "Upload failed (Write)");
			break;
		}
		received += (uint32_t)size;
	}
	fclose(fp);
	if (received != op->size) {
		remove(file_path);
		return -1;
	}

	ESP_LOGI(TAG, "Key [%s] uploaded (%ub)", op->name, (unsigned int)op->size);
	/* Re-build cache */
	app_ir_key_cache_build();
	/* Notify all connections that the key has changed */
	app_notify_key_changed();

	return 0;
}

/*
 * The tunnel session task: the only thread touching the session's
 * connections. It accepts clients on the listening socket (each one is
 * authenticated by tcp_crypto_accept), then serves operations from the
 * queue (CLOSE / DOWNLOAD / UPLOAD).
 */
static void tunnel_session_task(void *arg)
{
	struct tunnel_session *s = arg;
	struct tunnel_op_msg op;
	uint32_t idle;
	uint8_t ack;

	while (true) {
		/* A dead client (dropped after a failed transfer) is
		 * reclaimed before waiting for the next one */
		if (s->client && !tcp_crypto_is_connected(s->client)) {
			tcp_crypto_close(s->client);
			s->client = NULL;
		}

		/* Wait until the client is connected. accept() retries
		 * internally until the remaining idle time is used up (it
		 * re-accepts after a failed handshake), so no client within
		 * the idle timeout means the session is over. */
		while (!s->client) {
			idle = os_get_time_ms() - s->last_active_ms;
			if (idle >= TUNNEL_IDLE_TIMEOUT_MS)
				goto done;
			s->client = tcp_crypto_accept(s->listen_fd, s->key,
						TUNNEL_IO_BUF_SIZE,
						TUNNEL_IDLE_TIMEOUT_MS - idle);
			if (s->client) {
				ESP_LOGI(TAG, "Tunnel client connected (port %d)",
					 TUNNEL_PORT);
				s->last_active_ms = os_get_time_ms();
			}
		}

		/* Wait for the next operation */
		if (xQueueReceive(s->op_queue, &op,
				pdMS_TO_TICKS(TUNNEL_LOOP_TIMEOUT_MS)) != pdPASS) {
			/* Idle timeout */
			if (os_get_time_ms() - s->last_active_ms > TUNNEL_IDLE_TIMEOUT_MS)
				goto done;
			/* Data on the stream without a matching operation, or a
			 * closed peer, is not recoverable */
			if (tcp_crypto_peek(s->client) > 0) {
				ESP_LOGW(TAG, "Unexpected tunnel data or peer closed, closing");
				goto done;
			}
			continue;
		}

		switch (op.op) {
		case TUNNEL_OP_CLOSE:
			goto done;
		case TUNNEL_OP_DOWNLOAD:
			/* A failed download cannot send the promised data,
			 * end the session */
			if (app_tunnel_do_download(s->client, &op) < 0)
				goto done;
			break;
		case TUNNEL_OP_UPLOAD:
			/* Do not end the session on failure, the client can
			 * retry. Acknowledge once all the data has been received
			 * (1 = saved, 0 = failed); the client waits for the ack
			 * before the next upload, so the operation queue never
			 * runs ahead of the stream */
			ack = app_tunnel_do_upload(s->client, &op) == 0 ? 1 : 0;
			if (tcp_crypto_send(s->client, &ack, 1, TUNNEL_IO_TIMEOUT_MS) < 0)
				ESP_LOGE(TAG, "Upload ack send failed");
			break;
		default:
			continue;
		}
		s->last_active_ms = os_get_time_ms();

		/* Out-of-band data (or a closed peer) is not recoverable,
		 * unless the next operation is already queued and owns the
		 * stream */
		if (uxQueueMessagesWaiting(s->op_queue) == 0 &&
		    tcp_crypto_peek(s->client) > 0) {
			ESP_LOGW(TAG, "Unexpected tunnel data or peer closed, closing");
			goto done;
		}
	}

done:
	if (s->client)
		tcp_crypto_close(s->client);
	close(s->listen_fd);
	ESP_LOGI(TAG, "Tunnel session ended (port %d)", TUNNEL_PORT);
	s->finished = true;
	vTaskDelete(NULL);
}

/*
 * Open the tunnel listening socket on the fixed port.
 *
 * Returns the fd on success, <0 on failure.
 */
static int tunnel_open_listen_socket(void)
{
	struct sockaddr_in address;
	int operate = 1;
	int fd;

	fd = socket(AF_INET, SOCK_STREAM, 0);
	if (fd < 0) {
		ESP_LOGE(TAG, "Socket failed: %d", errno);
		return -1;
	}
	/* Allow binding a port held in TIME_WAIT by a previous session */
	setsockopt(fd, SOL_SOCKET, SO_REUSEADDR, &operate, sizeof(operate));
	memset(&address, 0, sizeof(address));
	address.sin_family = AF_INET;
	address.sin_addr.s_addr = INADDR_ANY;
	address.sin_port = htons(TUNNEL_PORT);
	if (bind(fd, (struct sockaddr *)&address, sizeof(address)) < 0) {
		ESP_LOGE(TAG, "Bind port %d failed: %d", TUNNEL_PORT, errno);
		close(fd);
		return -1;
	}
	if (listen(fd, 1) < 0) {
		ESP_LOGE(TAG, "Listen failed: %d", errno);
		close(fd);
		return -1;
	}
	return fd;
}

/* Create a new tunnel session and start its task */
static struct tunnel_session *tunnel_session_open(void)
{
	struct tunnel_session *s;

	s = (struct tunnel_session *)malloc(sizeof(*s));
	if (!s) {
		ESP_LOGE(TAG, "Tunnel session malloc failed");
		return NULL;
	}
	memset(s, 0, sizeof(*s));
	s->listen_fd = -1;
	s->client = NULL;

	s->op_queue = xQueueCreate(TUNNEL_SESSION_MAX_OPS,
			sizeof(struct tunnel_op_msg));
	if (!s->op_queue) {
		ESP_LOGE(TAG, "Tunnel queue create failed");
		free(s);
		return NULL;
	}

	/* Generate the tunnel key and open the listening socket */
	os_fill_random(s->key, TCP_CRYPTO_KEY_LENGTH);
	s->listen_fd = tunnel_open_listen_socket();
	if (s->listen_fd < 0) {
		ESP_LOGE(TAG, "Tunnel listen socket failed");
		vQueueDelete(s->op_queue);
		free(s);
		return NULL;
	}
	s->last_active_ms = os_get_time_ms();

	if (xTaskCreate(tunnel_session_task, "tunnel_session",
			TUNNEL_SESSION_STACK, s, tskIDLE_PRIORITY + 2,
			&s->task) != pdPASS) {
		ESP_LOGE(TAG, "Tunnel task create failed");
		close(s->listen_fd);
		vQueueDelete(s->op_queue);
		free(s);
		return NULL;
	}

	ESP_LOGI(TAG, "Tunnel session started (port %d)", TUNNEL_PORT);

	return s;
}

/* Free a dead session (the task has set finished and exited, the task
 * already closed the client and the listening socket) */
static void tunnel_session_free(struct tunnel_session *s)
{
	vQueueDelete(s->op_queue);
	free(s);
}

static int app_ir_request(char *buffer, int buf_offs, int vaild_size, int buff_size)
{
	/* The ctrl body task is the only caller of this handler; keep `op`
	 * static to save the task's small (3000 bytes) stack */
	static struct tunnel_op_msg op;
	uint32_t count;
	size_t len;
	FILE *fp;
	char file_path[SPIFFS_ROOT_PATH_LEN + 1 + IR_DATA_PREFIX_LEN + IR_KEY_NAME_LEN_MAX + 1];

	if (vaild_size < 1) {
		ESP_LOGE(TAG, "Information command is incorrect");
		return -1;
	}

	if (buff_size - buf_offs < 2)
		goto nomem_err;

	switch (buffer[buf_offs]) {
	case IR_CMD_GET_COUNT:		/* Get the number of keys */
		if (buff_size - buf_offs < 6)
			goto nomem_err;
		buffer[buf_offs + 1] = IR_RESULT_OK;
		buffer[buf_offs + 2] = (ir_key_count >> 0) & 0xff;
		buffer[buf_offs + 3] = (ir_key_count >> 8) & 0xff;
		buffer[buf_offs + 4] = (ir_key_count >> 16) & 0xff;
		buffer[buf_offs + 5] = (ir_key_count >> 24) & 0xff;
		return 6;
	case IR_CMD_GET_ITEM:		/* Get key information */
		if (vaild_size != 5)
			goto lllegal_err;
		if (buff_size - buf_offs < 2 + IR_KEY_NAME_LEN_MAX)
			goto nomem_err;
		count = (buffer[buf_offs + 1] << 0) |
			(buffer[buf_offs + 2] << 8) |
			(buffer[buf_offs + 3] << 16) |
			(buffer[buf_offs + 4] << 24);
		len = 0;
		if (count >= IR_KEY_NUM_MAX) {
			buffer[buf_offs + 1] = IR_RESULT_FAIL;
			ESP_LOGE(TAG, "Get failed, count incorrect");
		} else {
			if (ir_key_info[count].vaild) {
				len = strlen(ir_key_info[count].name);
				memcpy(buffer + buf_offs + 2, ir_key_info[count].name, len);
				buffer[buf_offs + 1] = IR_RESULT_OK;
			} else {
				buffer[buf_offs + 1] = IR_RESULT_DONE;
				ESP_LOGW(TAG, "Count invalid");
			}
		}
		return 2 + len;
	case IR_CMD_TX_TEST:		/* Testing received IR data */
		if (vaild_size != 5)
			goto lllegal_err;
		app_led_set_step('F');
		count = (buffer[buf_offs + 1] << 0) |
			(buffer[buf_offs + 2] << 8) |
			(buffer[buf_offs + 3] << 16) |
			(buffer[buf_offs + 4] << 24);
		xSemaphoreTake(ir_mutex, portMAX_DELAY);
		if (count == ir_rx_count) {
			ir_ctrl_tx_send_data(ir_rx_buff, ir_rx_len);
			buffer[buf_offs + 1] = IR_RESULT_OK;
			// ESP_LOGI(TAG, "Test okay");
		} else {
			buffer[buf_offs + 1] = IR_RESULT_FAIL;
			ESP_LOGE(TAG, "Test failed, count incorrect");
		}
		xSemaphoreGive(ir_mutex);
		return 2;
	case IR_CMD_SAVE:		/* Save the received IR key data */
		if (vaild_size < 1 + 4)
			goto lllegal_err;
		if (vaild_size - 1 - 4 > IR_KEY_NAME_LEN_MAX ||
		    IR_DATA_PREFIX_LEN + (vaild_size - 1 - 4) > IR_KEY_FILE_NAME_LEN_MAX) {
			buffer[buf_offs + 1] = IR_RESULT_FAIL;
			ESP_LOGE(TAG, "Save failed (The name is too long)");
			return 2;
		}
		count = (buffer[buf_offs + 1] << 0) |
			(buffer[buf_offs + 2] << 8) |
			(buffer[buf_offs + 3] << 16) |
			(buffer[buf_offs + 4] << 24);
		xSemaphoreTake(ir_mutex, portMAX_DELAY);
		if (count == ir_rx_count) {
			snprintf(file_path, sizeof(file_path), SPIFFS_ROOT_PATH "/" IR_DATA_PREFIX "%.*s",
				 vaild_size - 1 - 4, buffer + buf_offs + 1 + 4);
			ESP_LOGI(TAG, "Save file path: %s", file_path);
			fp = fopen(file_path, "wb+");
			if (fp) {
				len = fwrite(ir_rx_buff, sizeof(uint16_t), ir_rx_len, fp);
				fclose(fp);
				if (len == ir_rx_len) {
					/* Re-build cache */
					app_ir_key_cache_build();
					/* Notify all connections that the key has changed */
					app_notify_key_changed();
					buffer[buf_offs + 1] = IR_RESULT_OK;
					// ESP_LOGI(TAG, "Save okay");
				} else {
					remove(file_path);
					buffer[buf_offs + 1] = IR_RESULT_FAIL;
					ESP_LOGE(TAG, "Save failed (Write)");
				}
			} else {
				buffer[buf_offs + 1] = IR_RESULT_FAIL;
				ESP_LOGE(TAG, "Save failed (Open)");
			}
		} else {
			buffer[buf_offs + 1] = IR_RESULT_FAIL;
			ESP_LOGE(TAG, "Save failed (Count incorrect)");
		}
		xSemaphoreGive(ir_mutex);
		return 2;
	case IR_CMD_REMOVE:		/* Delete the specified key */
		if (vaild_size - 1 > IR_KEY_NAME_LEN_MAX) {
			buffer[buf_offs + 1] = IR_RESULT_FAIL;
			ESP_LOGE(TAG, "Remove failed (The name is too long)");
			return 2;
		}
		snprintf(file_path, sizeof(file_path), SPIFFS_ROOT_PATH "/" IR_DATA_PREFIX "%.*s",
			 vaild_size - 1, buffer + buf_offs + 1);
		ESP_LOGI(TAG, "Remove file path: %s", file_path);
		if (remove(file_path)) {
			buffer[buf_offs + 1] = IR_RESULT_FAIL;
			ESP_LOGE(TAG, "Remove failed");
		} else {
			/* Re-build cache */
			app_ir_key_cache_build();
			/* Notify all connections that the key has changed */
			app_notify_key_changed();
			buffer[buf_offs + 1] = IR_RESULT_OK;
			// ESP_LOGI(TAG, "Remove okay");
		}
		return 2;
	case IR_CMD_TX_SEND:		/* Send key signal */
		if (vaild_size - 1 > IR_KEY_NAME_LEN_MAX) {
			buffer[buf_offs + 1] = IR_RESULT_FAIL;
			ESP_LOGE(TAG, "IR Send failed (The name is too long)");
			return 2;
		}
		snprintf(file_path, sizeof(file_path), SPIFFS_ROOT_PATH "/" IR_DATA_PREFIX "%.*s",
			 vaild_size - 1, buffer + buf_offs + 1);
		ESP_LOGI(TAG, "IR data file path: %s", file_path);
		fp = fopen(file_path, "rb");
		if (fp) {
			len = fread(ir_rx_buff, sizeof(uint16_t), RX_BUFF_SIZE_MAX, fp);
			fclose(fp);
			ESP_LOGI(TAG, "IR data %dp", len);
			if (len > 0) {
				app_led_set_step('F');
				ir_rx_len = (uint16_t)len;
				ir_ctrl_tx_send_data(ir_rx_buff, ir_rx_len);
				/* Notify send done */
				buffer[buf_offs + 0] = IR_NOTIFY_TYPE_TX;
				simple_ctrl_notify(buffer + buf_offs, vaild_size);
				/* Return OK */
				buffer[buf_offs + 0] = IR_CMD_TX_SEND;
				buffer[buf_offs + 1] = IR_RESULT_OK;
				// ESP_LOGI(TAG, "IR send okay");
			} else {
				buffer[buf_offs + 1] = IR_RESULT_FAIL;
				ESP_LOGE(TAG, "IR send failed (Read)");
			}
		} else {
			buffer[buf_offs + 1] = IR_RESULT_FAIL;
			ESP_LOGE(TAG, "IR send failed (Open)");
		}
		return 2;
	case IR_CMD_OPEN_TUNNEL:		/* Open the tunnel */
		/* Response: [cmd, result, port(2bytes), key(16bytes)] */
		if (vaild_size != 1)
			goto lllegal_err;
		if (buff_size - buf_offs < 4 + TCP_CRYPTO_KEY_LENGTH)
			goto nomem_err;

		if (tunnel && !tunnel->finished) {
			/*
			 * Single user: reject if a tunnel is already open
			 * (a closing one counts as open too). The old
			 * session ends on its own (CLOSE operation or idle
			 * timeout) and the next OPEN reclaims it.
			 */
			buffer[buf_offs + 1] = IR_RESULT_FAIL;
			ESP_LOGE(TAG, "Open failed (Tunnel already open)");
			return 2;
		}
		if (tunnel) {
			/* Reclaim the dead session */
			tunnel_session_free(tunnel);
			tunnel = NULL;
		}

		tunnel = tunnel_session_open();
		if (!tunnel) {
			buffer[buf_offs + 1] = IR_RESULT_FAIL;
			ESP_LOGE(TAG, "Open tunnel failed");
			return 2;
		}

		buffer[buf_offs + 1] = IR_RESULT_OK;
		buffer[buf_offs + 2] = TUNNEL_PORT & 0xff;
		buffer[buf_offs + 3] = (TUNNEL_PORT >> 8) & 0xff;
		memcpy(buffer + buf_offs + 4, tunnel->key, TCP_CRYPTO_KEY_LENGTH);
		return 4 + TCP_CRYPTO_KEY_LENGTH;
	case IR_CMD_CLOSE_TUNNEL:	/* Close the tunnel */
		if (vaild_size != 1)
			goto lllegal_err;
		if (tunnel) {
			if (tunnel->finished) {
				/* The session is already dead, reclaim it */
				tunnel_session_free(tunnel);
				tunnel = NULL;
			} else {
				/* The session task will close the transport */
				memset(&op, 0, sizeof(op));
				op.op = TUNNEL_OP_CLOSE;
				xQueueSend(tunnel->op_queue, &op, (TickType_t)0);
			}
		}
		buffer[buf_offs + 1] = IR_RESULT_OK;
		return 2;
	case IR_CMD_DOWNLOAD_KEY:	/* Download a key via the tunnel */
		/* Request: [cmd, name]
		 * Response: [cmd, result, size(4bytes)], then the client
		 * reads the data from the tunnel */
		if (vaild_size < 2 || vaild_size - 1 > IR_KEY_NAME_LEN_MAX)
			goto lllegal_err;
		if (!tunnel || tunnel->finished) {
			buffer[buf_offs + 1] = IR_RESULT_FAIL;
			ESP_LOGE(TAG, "Download failed (Tunnel not opened)");
			return 2;
		}
		memset(&op, 0, sizeof(op));
		op.op = TUNNEL_OP_DOWNLOAD;
		memcpy(op.name, buffer + buf_offs + 1, vaild_size - 1);
		/* The key must exist */
		if (app_key_get_size(op.name, &op.size) != 0 ||
		    op.size == 0 || op.size > TUNNEL_KEY_DATA_MAX) {
			buffer[buf_offs + 1] = IR_RESULT_FAIL;
			ESP_LOGE(TAG, "Download failed (Key not exist)");
			return 2;
		}
		if (buff_size - buf_offs < 6)
			goto nomem_err;
		if (xQueueSend(tunnel->op_queue, &op, (TickType_t)0) != pdPASS) {
			buffer[buf_offs + 1] = IR_RESULT_FAIL;
			ESP_LOGE(TAG, "Download failed (Busy)");
			return 2;
		}
		buffer[buf_offs + 1] = IR_RESULT_OK;
		buffer[buf_offs + 2] = op.size & 0xff;
		buffer[buf_offs + 3] = (op.size >> 8) & 0xff;
		buffer[buf_offs + 4] = (op.size >> 16) & 0xff;
		buffer[buf_offs + 5] = (op.size >> 24) & 0xff;
		return 6;
	case IR_CMD_UPLOAD_KEY:		/* Upload a key via the tunnel */
		/* Request: [cmd, size(4bytes), name]
		 * If the key exists it will be overwritten, otherwise it is
		 * created. After this response the client sends the key
		 * data to the tunnel. */
		if (vaild_size < 1 + 4 + 1 || vaild_size - 1 - 4 > IR_KEY_NAME_LEN_MAX)
			goto lllegal_err;
		if (IR_DATA_PREFIX_LEN + (vaild_size - 1 - 4) > IR_KEY_FILE_NAME_LEN_MAX) {
			buffer[buf_offs + 1] = IR_RESULT_FAIL;
			ESP_LOGE(TAG, "Upload failed (The name is too long)");
			return 2;
		}
		if (!tunnel || tunnel->finished) {
			buffer[buf_offs + 1] = IR_RESULT_FAIL;
			ESP_LOGE(TAG, "Upload failed (Tunnel not opened)");
			return 2;
		}
		memset(&op, 0, sizeof(op));
		op.op = TUNNEL_OP_UPLOAD;
		op.size = (buffer[buf_offs + 1] << 0) |
			(buffer[buf_offs + 2] << 8) |
			(buffer[buf_offs + 3] << 16) |
			(buffer[buf_offs + 4] << 24);
		if (op.size == 0 || op.size > TUNNEL_KEY_DATA_MAX) {
			buffer[buf_offs + 1] = IR_RESULT_FAIL;
			ESP_LOGE(TAG, "Upload failed (Size incorrect)");
			return 2;
		}
		memcpy(op.name, buffer + buf_offs + 1 + 4, vaild_size - 1 - 4);
		if (xQueueSend(tunnel->op_queue, &op, (TickType_t)0) != pdPASS) {
			buffer[buf_offs + 1] = IR_RESULT_FAIL;
			ESP_LOGE(TAG, "Upload failed (Busy)");
			return 2;
		}
		buffer[buf_offs + 1] = IR_RESULT_OK;
		return 2;
	default:
		goto lllegal_err;
	}

	return 0;
nomem_err:
	ESP_LOGE(TAG, "Not enough buffer space");
	return -1;
lllegal_err:
	ESP_LOGE(TAG, "Lllegal command");
	return -1;
}

static void app_led_task(void *arg)
{
	TickType_t xTicksToWait = portMAX_DELAY;
	char step;
	uint8_t red_value = 0;
	uint8_t green_value = 0;
	bool is_green = false;
	char recyclable_step = 0;

	while(1) {
		xQueueReceive(led_queue, &step, xTicksToWait);
		switch (step) {
		case 'r':
			xTicksToWait = portMAX_DELAY;
			green_value = 0;
			red_value = LED_RED_BRIGHTNESS_MAX;
			is_green = false;
			recyclable_step = step;
			break;
		case 'g':
			xTicksToWait = pdMS_TO_TICKS(10000);;
			red_value = 0;
			green_value = LED_GREEN_BRIGHTNESS_MAX;
			is_green = true;
			recyclable_step = step;
			step = 'P';
			break;
		case 'C':
			xTicksToWait = pdMS_TO_TICKS(100);
			red_value = red_value ? 0 : LED_RED_BRIGHTNESS_MAX;
			green_value = red_value ? 0 : LED_GREEN_BRIGHTNESS_MAX;
			recyclable_step = step;
			break;
		case 'P':
			xTicksToWait = portMAX_DELAY;
			green_value = 0;
			recyclable_step = step;
			break;
		case (char)-'P':
			recyclable_step = step;
			if (is_green) {
				xTicksToWait = 0;
				step = 'g';
			} else {
				xTicksToWait = portMAX_DELAY;
			}
			break;
		case 'F':
			gpio_led_set_red_brightness(LED_RED_BRIGHTNESS_MAX);
			gpio_led_set_green_brightness(0);
			vTaskDelay(pdMS_TO_TICKS(40));
			gpio_led_set_red_brightness(0);
			gpio_led_set_green_brightness(LED_GREEN_BRIGHTNESS_MAX);
			vTaskDelay(pdMS_TO_TICKS(40));
			step = recyclable_step;
			break;
		default:
			ESP_LOGW(TAG, "unknow step: %d", step);
		}
		gpio_led_set_red_brightness(red_value);
		gpio_led_set_green_brightness(green_value);
	}

	vQueueDelete(led_queue);
	vTaskDelete(NULL);
}

static bool app_event_notify_callback(struct event_bus_msg *msg)
{
	switch (msg->type) {
	case EVENT_BUS_STARTUP:
		app_led_set_step('r');
		break;
	case EVENT_BUS_WIFI_CONNECTED:
		app_led_set_step('g');
		break;
	case EVENT_BUS_WIFI_DISCONNECTED:
		app_led_set_step('r');
		break;
	case EVENT_BUS_START_SMART_CONFIG:
		app_led_set_step('C');
		break;
	case EVENT_BUS_STOP_SMART_CONFIG:
		config_mode = false;
		break;
	case EVENT_BUS_KEYBOARD:
		if (config_mode || msg->param1 != KEYBOARD_GPIO_PIN)
			break;
		if ((msg->param2 == KEYBOARD_EVENT_SHORT_RELEASE)) {
			// ESP_LOGW(TAG, "Restarting now");
			// fflush(stdout);
			// esp_restart();
			app_led_set_step(-'P');
		}
		/* Smart config */
		if (msg->param2 == KEYBOARD_EVENT_LONG_RELEASE) {
			ESP_LOGI(TAG, "Smart config");
			wifi_smartconfig();
			config_mode = true;
		}
		break;
	case EVENT_BUS_IR_RX:
		ESP_LOGI(TAG, "IR received");
		break;
	}

	return false;
}

static void app_ir_rx_callback(uint16_t *data, uint16_t len)
{
	char buffer[7];

	ESP_LOGI(TAG, "IR data len: %up, rx count: %u", len, ir_rx_count);
	app_led_set_step('F');

	xSemaphoreTake(ir_mutex, portMAX_DELAY);
	memcpy(ir_rx_buff, data, len * sizeof(uint16_t));
	ir_rx_len = len;
	ir_rx_count++;
	xSemaphoreGive(ir_mutex);

	/* Notify all connected devices that IR key data has been received */
	buffer[0] = IR_NOTIFY_TYPE_RX;
	buffer[1] = (char)((ir_rx_count >> 0) & 0xff);
	buffer[2] = (char)((ir_rx_count >> 8) & 0xff);
	buffer[3] = (char)((ir_rx_count >> 16) & 0xff);
	buffer[4] = (char)((ir_rx_count >> 24) & 0xff);
	buffer[5] = (char)((len >> 0) & 0xff);
	buffer[6] = (char)((len >> 8) & 0xff);
	simple_ctrl_notify(buffer, sizeof(buffer));
}

/* The OTA transports this device supports (url scheme -> callbacks). */
static const struct ota_transport ota_transports[] = {
	{ "hoozz", hoozz_ota_open, hoozz_ota_size, hoozz_ota_read, hoozz_ota_close },
};

void app_main(void)
{
	struct event_bus_msg msg = { EVENT_BUS_STARTUP, 0, 0};
	uint8_t keyboard_gpios[] = { KEYBOARD_GPIO_PIN };

	print_build_info();
	print_chip_info();
	app_show_info();

	/* GPIO LED */
	gpio_led_init(LED_RED_GPIO_PIN, LED_GREEN_GPIO_PIN);
	led_queue = xQueueCreate(10, sizeof(char));
	ESP_ERROR_CHECK(led_queue == NULL);
	ESP_ERROR_CHECK(xTaskCreate(app_led_task, "app_led_task", 1024,
			NULL, tskIDLE_PRIORITY + 2, NULL) != pdPASS);

	/* NVS init */
	ESP_ERROR_CHECK(nvs_flash_init());

	/* Enable OTA (after NVS: the ESP-IDF flash backend's first-boot
	 * validation stores its state there) */
	simple_ctrl_ota_enable(APP_GIT_SHA APP_GIT_DIRTY, ota_transports,
			sizeof(ota_transports) / sizeof(ota_transports[0]),
			&esp_idf_ota_flash);

	/* install gpio isr service */
	ESP_ERROR_CHECK(gpio_install_isr_service(0));

	store_init();

	/* Event bus */
	event_bus_init();
	event_bus_register(app_event_notify_callback);
	event_bus_send(&msg);

	/* Keyboard */
	keyboard_init(keyboard_gpios, sizeof(keyboard_gpios));

	/* IR */
	ir_mutex = xSemaphoreCreateMutex();
	app_ir_key_cache_build();
	ir_ctrl_init(IR_RX_GPIO_PIN, IR_TX_GPIO_PIN, app_ir_rx_callback);

	/* Wifi */
	wifi_init();

	/* Network ctrl */
	simple_ctrl_init("SMART IR");
	simple_ctrl_set_class_id(CLASS_ID_SMART_IR);
	simple_ctrl_request_register(app_ir_request);
	wifi_connect();

	app_show_info();
}
